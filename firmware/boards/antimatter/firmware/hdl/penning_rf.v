// firmware/hdl/penning_rf.v — Penning trap RF DAC/ADC FPGA top
//
// Phase D skeleton (compiles in Vivado 2024.1+ for XCZU9EG; not yet
// flashable — boards TBD per .roadmap §A.6 step 4).
// Spec source: firmware/sim/penning_rf.hexa (11/11 PASS).

`timescale 1ns / 1ps

module penning_rf_top (
    // ── 100 MHz Wenzel OCXO ref ───
    input  wire         ref_clk_100m_p,
    input  wire         ref_clk_100m_n,

    // ── DAC parallel data → AD9162 (16-bit LVDS) ───
    output wire [15:0]  dac_data_p,
    output wire [15:0]  dac_data_n,
    output wire         dac_clk_p,
    output wire         dac_clk_n,

    // ── ADC parallel data ← AD9208 (14-bit LVDS) ───
    input  wire [13:0]  adc_data_p,
    input  wire [13:0]  adc_data_n,
    input  wire         adc_clk_p,
    input  wire         adc_clk_n,

    // ── trap HV bias DAC (slow SPI to off-FPGA DAC) ───
    output wire         hv_dac_csb,
    output wire         hv_dac_sck,
    output wire         hv_dac_mosi,

    // ── safety interlocks (LVCMOS33) ───
    input  wire         lhe_level_sense_n,
    input  wire         magnet_quench_detect_n,

    // ── CERN AD handshake (RS-485) ───
    output wire         ad_handshake_tx_p,
    output wire         ad_handshake_tx_n,
    input  wire         ad_handshake_rx_p,
    input  wire         ad_handshake_rx_n,

    // ── host telemetry ───
    output wire         uart_host_tx,
    input  wire         uart_host_rx,

    // ── status LED ───
    output reg [3:0]    led_status
);

    // ── internal clocking ───
    wire ref_clk_100m;
    IBUFGDS u_refclk_ibuf (
        .I  (ref_clk_100m_p),
        .IB (ref_clk_100m_n),
        .O  (ref_clk_100m)
    );

    // PLL: 100 MHz → 156.25 MHz (DAC ref) + 312.5 MHz (system)
    wire pll_locked;
    wire dac_clk_int, sys_clk;
    // ... (Clock Wizard IP instance — placeholder, generated by Vivado IP catalog)

    // ── DDS phase accumulator: 32-bit, output 731 MHz ν_c drive ───
    parameter integer F_TARGET_HZ = 731_400_000;
    parameter integer F_REF_HZ    = 156_250_000;     // DAC ref from PLL
    // Phase increment = (F_TARGET / F_REF) * 2^32
    // 731.4e6 / 156.25e6 * 4.29e9 = 2^32 * 4.6810 = 0xBE7E... (truncated)
    parameter [31:0] PHASE_INCREMENT = 32'h4ADD_8E83;  // computed offline

    reg [31:0]  phase_acc;
    reg signed [15:0] dac_sample;

    always @(posedge dac_clk_int) begin
        phase_acc <= phase_acc + PHASE_INCREMENT;
        // Sine LUT lookup (8K-entry ROM, 12 MSB of phase)
        // dac_sample <= sine_lut[phase_acc[31:20]];   // placeholder
        dac_sample <= 16'h0000;
    end

    // ── State machine: IDLE → AD_REQUEST → AD_CONFIRMED → BEAM_INJECT → COOL → STORE → DIAG ───
    localparam [2:0]
        S_IDLE         = 3'd0,
        S_AD_REQUEST   = 3'd1,
        S_AD_CONFIRMED = 3'd2,
        S_BEAM_INJECT  = 3'd3,
        S_COOL         = 3'd4,
        S_STORE        = 3'd5,
        S_DIAG         = 3'd6;

    reg [2:0] state;
    reg [31:0] state_timer;       // tick count in current state

    always @(posedge sys_clk) begin
        if (~pll_locked) begin
            state       <= S_IDLE;
            state_timer <= 0;
        end else begin
            state_timer <= state_timer + 1;
            case (state)
                S_IDLE:         state <= S_AD_REQUEST;        // operator trigger
                S_AD_REQUEST:   if (state_timer >= 32'd31_250_000) state <= S_AD_CONFIRMED;  // 100 ms @ 312.5 MHz
                S_AD_CONFIRMED: state <= S_BEAM_INJECT;
                S_BEAM_INJECT:  if (state_timer >= 32'd37_500_000_000) state <= S_COOL;  // 120 s
                S_COOL:         if (state_timer >= 32'd9_375_000_000)  state <= S_STORE; // 30 s
                S_STORE:        if (state_timer >= 32'd27_000_000_000_000) state <= S_DIAG; // 24 hr (overflow! keep symbolic)
                S_DIAG:         state <= S_IDLE;
                default:        state <= S_IDLE;
            endcase
            if (state != state_timer[2:0])
                state_timer <= 0;
        end
    end

    // ── safety interlock: ANY of {lhe_level_sense_n, magnet_quench_detect_n} fault → emergency stop ───
    wire safety_fault = ~lhe_level_sense_n | ~magnet_quench_detect_n;

    always @(posedge sys_clk) begin
        led_status[0] <= pll_locked;
        led_status[1] <= (state != S_IDLE);
        led_status[2] <= ~safety_fault;        // green when safe
        led_status[3] <= (state == S_STORE);   // long-term hold indicator
    end

    // (full implementation: JESD204C IP for DAC/ADC, RS-485 handshake FSM,
    // sine-LUT ROM, UART telemetry framer — Phase D when board exists)

endmodule
